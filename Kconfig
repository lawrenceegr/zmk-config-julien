## boards/arm/keyboard_h723zg/Kconfig.board
```kconfig
# Copyright (c) 2026 Lawrence Langat <lawrencelangatmi@gmail.com>
# SPDX-License-Identifier: Apache-2.0

config BOARD_KEYBOARD_H723ZG
    bool "Julien Keyboard"
	select SOC_STM32H723XX
```

## boards/arm/keyboard_h723zg/Kconfig.defconfig
```kconfig
# STM32H723ZG-Based Keyboard configuration

# Copyright (c) 2026 Lawrence Langat <lawrencelangatmi@gmail.com>
# SPDX-License-Identifier: Apache-2.0

if BOARD_KEYBOARD_H723ZG

config ZMK_KEYBOARD_NAME
	default "Julien Keyboard"

config ZMK_KSCAN_MATRIX_POLLING
    default y

config ZMK_KSCAN_MATRIX_WAIT_BETWEEN_OUTPUTS
    default 100

config ZMK_KSCAN_MATRIX_WAIT_BEFORE_INPUTS
    default 100

# config BT_CTLR
#     default BT 

endif # BOARD_KEYBOARD_H723ZG
```

## boards/arm/keyboard_h723zg/keyboard_h723zg_defconfig
```kconfig
# SPDX-License-Identifier: Apache-2.0

CONFIG_BOARD_KEYBOARD_H723ZG=y

CONFIG_GPIO=y
CONFIG_I2C=y
CONFIG_LED=y

CONFIG_IS31FL3733_BRIDGE=y
CONFIG_ZMK_RGB_UNDERGLOW=y
CONFIG_ZMK_RGB_UNDERGLOW_EXT_POWER=n

CONFIG_ZMK_USB=y
CONFIG_ZMK_USB_STACK_NEXT=y

CONFIG_HW_STACK_PROTECTION=n
CONFIG_ARM_MPU=n

CONFIG_SERIAL=y
CONFIG_LOG=y
CONFIG_CONSOLE=y
CONFIG_UART_CONSOLE=y

CONFIG_PICOLIBC=n
CONFIG_MINIMAL_LIBC=y

CONFIG_SPI=y
CONFIG_FLASH=y
CONFIG_FLASH_PAGE_LAYOUT=y
CONFIG_FLASH_MAP=y
CONFIG_SPI_NOR=y
CONFIG_SPI_NOR_SFDP_RUNTIME=y
CONFIG_SPI_NOR_FLASH_LAYOUT_PAGE_SIZE=4096
CONFIG_NVS=y
CONFIG_SETTINGS=y
CONFIG_SETTINGS_NVS=y

CONFIG_EC11=y
CONFIG_EC11_TRIGGER_GLOBAL_THREAD=y
```

## boards/arm/vadox_v1/Kconfig.vadox_v1
```kconfig
# Copyright (c) 2026 Lawrence Langat <lawrencelangatmi@gmail.com>
# SPDX-License-Identifier: Apache-2.0

config BOARD_VADOX_V1
    bool "Vadox V1"
	select SOC_STM32H723XX
```

## boards/arm/vadox_v2/Kconfig.board
```kconfig
# Copyright (c) 2026 Lawrence Langat <lawrencelangatmi@gmail.com>
# SPDX-License-Identifier: Apache-2.0

config BOARD_VADOX_V2
    bool "Vadox V2"
	select SOC_STM32H723XX
```

## config/boards/arm/ms88sf3_nrf52840/Kconfig.board
```kconfig
config BOARD_MS88SF3_NRF52840
	bool "MS88SF3 nRF52840 Module"
	depends on SOC_NRF52840_QIAA
```

## config/boards/arm/ms88sf3_nrf52840/Kconfig.defconfig
```kconfig
# Copyright (c) 2024
# SPDX-License-Identifier: MIT

if BOARD_MS88SF3_NRF52840

config BOARD
	default "ms88sf3_nrf52840"

config ZMK_KEYBOARD_NAME
	default "Macropad"

if USB_DEVICE_STACK

config USB_NRFX
    default y

endif # USB_DEVICE_STACK

config BT_CTLR
    default BT

config BT_CTLR
	default BT

endif # BOARD_MS88SF3_NRF52840
```

## config/boards/arm/ms88sf3_nrf52840/ms88sf3_nrf52840_defconfig
```kconfig
# SPDX-License-Identifier: MIT

# Enable hardware stack protection
CONFIG_HW_STACK_PROTECTION=y

# Enable GPIO
CONFIG_GPIO=y

CONFIG_USE_DT_CODE_PARTITION=y
CONFIG_BUILD_OUTPUT_UF2=y

CONFIG_MPU_ALLOW_FLASH_WRITE=y
CONFIG_NVS=y
CONFIG_SETTINGS_NVS=y
CONFIG_FLASH=y
CONFIG_FLASH_PAGE_LAYOUT=y
CONFIG_FLASH_MAP=y

CONFIG_ZMK_RGB_UNDERGLOW=y
CONFIG_ZMK_RGB_UNDERGLOW_EXT_POWER=n
CONFIG_ZMK_EXT_POWER=n

CONFIG_ZMK_RGB_UNDERGLOW_HUE_START=160
CONFIG_ZMK_RGB_UNDERGLOW_EFF_START=3

CONFIG_ZMK_USB=y
CONFIG_ZMK_BLE=y

# Console Configuration
CONFIG_CONSOLE=y
CONFIG_USE_SEGGER_RTT=y
CONFIG_RTT_CONSOLE=y
CONFIG_UART_CONSOLE=n
```

## config/boards/generic/keyboard_h723zg/Kconfig.defconfig
```kconfig
# STM32H723ZG-Based Keyboard configuration

# Copyright (c) 2026 Lawrence Langat <lawrencelangatmi@gmail.com>
# SPDX-License-Identifier: Apache-2.0

if BOARD_KEYBOARD_H723ZG

config ZMK_KEYBOARD_NAME
	default "Julien Keyboard"

config ZMK_KSCAN_MATRIX_POLLING
    default y

endif # BOARD_KEYBOARD_H723ZG
```

## config/boards/generic/keyboard_h723zg/board.yml
```yaml
board:
  name: keyboard_h723zg
  vendor: generic
  socs:
    - name: stm32h723xx
```

## config/boards/generic/keyboard_h723zg/keyboard_h723zg_defconfig
```kconfig
# SPDX-License-Identifier: Apache-2.0

# Enable MPU
CONFIG_ARM_MPU=y

# Enable HW stack protection
CONFIG_HW_STACK_PROTECTION=y

# Enable UART
CONFIG_SERIAL=y

CONFIG_LOG=y
# Console
CONFIG_CONSOLE=y
CONFIG_UART_CONSOLE=y

# Enable GPIO
CONFIG_GPIO=y

CONFIG_ZMK_USB=y

CONFIG_PICOLIBC=n
CONFIG_MINIMAL_LIBC=y
```

## config/boards/ms88sf3_nrf52840/Kconfig
```kconfig
config BOARD_ENABLE_DCDC
    bool "Enable DCDC mode"
    select SOC_DCDC_NRF52X
    default y
    depends on BOARD_MS88SF3_NRF52840
```

## config/boards/ms88sf3_nrf52840/Kconfig.board
```kconfig
config BOARD_HOLYIOT_18010
	bool "Ms88sf3 nrf52840 nRF52840 Module"
	depends on SOC_NRF52840_QIAA
```

## config/boards/ms88sf3_nrf52840/Kconfig.defconfig
```kconfig
# Copyright (c) 2024
# SPDX-License-Identifier: MIT

if BOARD_MS88SF3_NRF52840

config BOARD
	default "ms88sf3_nrf52840"

config ZMK_KEYBOARD_NAME
	default "Macropad"

if USB_DEVICE_STACK

config USB_NRFX
	default y

config USB_DEVICE_REMOTE_WAKEUP
	default n

endif # USB_DEVICE_STACK

config BT_CTLR
	default BT

config ZMK_BLE
	default y

config ZMK_USB
	default y

endif # BOARD_MS88SF3_NRF52840
```

## config/boards/ms88sf3_nrf52840/Kconfig.ms88sf3_nrf52840
```kconfig
# MS88SF3 NRF52840 board configuration

# Copyright (c) 2024 Marcus
# SPDX-License-Identifier: MIT

config BOARD_MS88SF3_NRF52840
	select SOC_NRF52840_QIAA
```

## config/boards/ms88sf3_nrf52840/board.yml
```yaml
board:
  name: ms88sf3_nrf52840
  full_name: MS88SF3 NRF52840
  vendor: generic
  socs:
    - name: nrf52840
```

## config/boards/ms88sf3_nrf52840/ms88sf3_nrf52840_defconfig
```kconfig
# SPDX-License-Identifier: MIT

# Enable hardware stack protection
CONFIG_HW_STACK_PROTECTION=y

# Enable GPIO
CONFIG_GPIO=y

CONFIG_USE_DT_CODE_PARTITION=y
CONFIG_BUILD_OUTPUT_UF2=y

CONFIG_MPU_ALLOW_FLASH_WRITE=y
CONFIG_NVS=y
CONFIG_SETTINGS_NVS=y
CONFIG_FLASH=y
CONFIG_FLASH_PAGE_LAYOUT=y
CONFIG_FLASH_MAP=y
```

## drivers/led/Kconfig
```kconfig
config IS31FL3733_BRIDGE
	bool "IS31FL3733 to LED strip bridge"
	depends on LED
	help
	  Wraps the two IS31FL3733 LED matrix devices as a single led_strip
	  device so ZMK RGB underglow can drive them.
```

## dts/bindings/zmk,is31fl3733-bridge.yaml
```yaml
description: IS31FL3733 LED matrix to LED strip bridge

compatible: "zmk,is31fl3733-bridge"

include: base.yaml

properties:
  chain-length:
    type: int
    required: true
    description: Number of addressable RGB pixels
```
